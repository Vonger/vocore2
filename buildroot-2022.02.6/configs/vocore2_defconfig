## buildroot-2022.02.6/configs/vocore2_defconfig
```kconfig
# target
BR2_mipsel=y
BR2_mips_32r2=y

# toolchain
BR2_TOOLCHAIN_BUILDROOT_VENDOR="mt76x8"
BR2_TOOLCHAIN_BUILDROOT_MUSL=y
BR2_PACKAGE_HOST_GDB=y

# kernel
BR2_LINUX_KERNEL=y
BR2_LINUX_KERNEL_USE_CUSTOM_CONFIG=y
BR2_LINUX_KERNEL_PATCH="$(BR2_EXTERNAL_VOCORE2_PATH)/board/vocore2/linux/"
BR2_LINUX_KERNEL_CUSTOM_CONFIG_FILE="$(BR2_EXTERNAL_VOCORE2_PATH)/board/vocore2/linux/linux-5.15.config"
BR2_LINUX_KERNEL_DTS_SUPPORT=y
BR2_LINUX_KERNEL_DTB_IS_SELF_BUILT=y
BR2_LINUX_KERNEL_INTREE_DTS_NAME="vocore2"
BR2_LINUX_KERNEL_DTB_OVERLAY_SUPPORT=y

# package
BR2_PACKAGE_BUSYBOX_CONFIG_FRAGMENT_FILES="$(BR2_EXTERNAL_VOCORE2_PATH)/board/vocore2/busybox/busybox-extra.config"

# image
BR2_TARGET_ROOTFS_CPIO=y
BR2_TARGET_ROOTFS_CPIO_GZIP=y
BR2_TARGET_ROOTFS_INITRAMFS=y

# uboot
BR2_TARGET_UBOOT=y
BR2_TARGET_UBOOT_USE_CUSTOM_CONFIG=y
BR2_TARGET_UBOOT_CUSTOM_CONFIG_FILE="$(BR2_EXTERNAL_VOCORE2_PATH)/../uboot/vocore2_defconfig"
BR2_TARGET_UBOOT_PATCH="$(BR2_EXTERNAL_VOCORE2_PATH)/../uboot/patches/"
BR2_TARGET_UBOOT_NEEDS_DTC=y
# BR2_TARGET_UBOOT_FORMAT_BIN is not set
BR2_TARGET_UBOOT_FORMAT_CUSTOM=y
BR2_TARGET_UBOOT_FORMAT_CUSTOM_NAME="u-boot-with-spl.bin"
```

## buildroot/configs/vocore2_defconfig
```kconfig
# target
BR2_mipsel=y
BR2_mips_32r2=y

# toolchain
BR2_TOOLCHAIN_BUILDROOT_VENDOR="mt76x8"
BR2_TOOLCHAIN_BUILDROOT_MUSL=y
BR2_PACKAGE_HOST_GDB=y

# build options
BR2_ENABLE_LTO=y

# system configuration
BR2_TARGET_GENERIC_HOSTNAME="vocore2"

# kernel
BR2_LINUX_KERNEL=y
BR2_LINUX_KERNEL_USE_CUSTOM_CONFIG=y
BR2_LINUX_KERNEL_PATCH="$(BR2_EXTERNAL_VOCORE2_PATH)/board/vocore2/linux/patches/"
BR2_LINUX_KERNEL_CUSTOM_CONFIG_FILE="$(BR2_EXTERNAL_VOCORE2_PATH)/board/vocore2/linux/linux.config"
BR2_LINUX_KERNEL_LZMA=y

# firmware
BR2_PACKAGE_MT76_FIRMWARE=y
BR2_PACKAGE_MT76_FIRMWARE_MT7628=y

# package
BR2_PACKAGE_BUSYBOX_CONFIG_FRAGMENT_FILES="$(BR2_EXTERNAL_VOCORE2_PATH)/board/vocore2/busybox/busybox-extra.config"
BR2_PACKAGE_WIRELESS_REGDB=y
BR2_PACKAGE_WIRELESS_TOOLS=y
BR2_PACKAGE_WPA_SUPPLICANT=y
BR2_PACKAGE_HOSTAPD=y

# image
BR2_ROOTFS_POST_BUILD_SCRIPT="$(BR2_EXTERNAL_VOCORE2_PATH)/board/vocore2/post-build.sh"
BR2_ROOTFS_POST_IMAGE_SCRIPT="$(BR2_EXTERNAL_VOCORE2_PATH)/board/vocore2/post-image.sh"
# BR2_TARGET_ROOTFS_TAR is not set
BR2_TARGET_ROOTFS_SQUASHFS=y
BR2_TARGET_ROOTFS_SQUASHFS_PAD=y
BR2_TARGET_ROOTFS_SQUASHFS4_XZ=y

# uboot
BR2_TARGET_UBOOT=y
BR2_TARGET_UBOOT_USE_CUSTOM_CONFIG=y
BR2_TARGET_UBOOT_CUSTOM_CONFIG_FILE="$(BR2_EXTERNAL_VOCORE2_PATH)/../uboot/vocore2_defconfig"
BR2_TARGET_UBOOT_NEEDS_DTC=y
# BR2_TARGET_UBOOT_FORMAT_BIN is not set
BR2_TARGET_UBOOT_FORMAT_CUSTOM=y
BR2_TARGET_UBOOT_FORMAT_CUSTOM_NAME="u-boot-with-spl.bin"

# host
BR2_PACKAGE_HOST_GENIMAGE=y
```

## buildroot/configs/vocore2_flasher_defconfig
```kconfig
# target
BR2_mipsel=y
BR2_mips_32r2=y

# toolchain
BR2_TOOLCHAIN_BUILDROOT_VENDOR="mt76x8"
BR2_TOOLCHAIN_BUILDROOT_MUSL=y
BR2_PACKAGE_HOST_GDB=y

# build options
BR2_ENABLE_LTO=y

# system configuration
BR2_TARGET_GENERIC_HOSTNAME="vocore2_flasher"

# kernel
BR2_LINUX_KERNEL=y
BR2_LINUX_KERNEL_USE_CUSTOM_CONFIG=y
BR2_LINUX_KERNEL_PATCH="$(BR2_EXTERNAL_VOCORE2_PATH)/board/vocore2_flasher/linux/patches/"
BR2_LINUX_KERNEL_CUSTOM_CONFIG_FILE="$(BR2_EXTERNAL_VOCORE2_PATH)/board/vocore2_flasher/linux/linux.config"
BR2_LINUX_KERNEL_LZMA=y

# package
BR2_PACKAGE_BUSYBOX_CONFIG_FRAGMENT_FILES="$(BR2_EXTERNAL_VOCORE2_PATH)/board/vocore2_flasher/busybox/busybox-extra.config"

# image
# BR2_TARGET_ROOTFS_TAR is not set
BR2_TARGET_ROOTFS_INITRAMFS=y
```

## buildroot/package/mt76-firmware/Config.in
```kconfig
config BR2_PACKAGE_MT76_FIRMWARE
	bool "mt76-firmware"
	help
	  This package provides various binary firmware files (closed
	  binary blobs) for mt76 devices's WLAN cards.

	  https://github.com/openwrt/mt76

if BR2_PACKAGE_MT76_FIRMWARE


config BR2_PACKAGE_MT76_FIRMWARE_MT7628
	bool "mt7628 firmware"
	help
	  Firmware for mt7628's wifi mcu.

endif
```

## openwrt.2203/v2u_defconfig
```kconfig
# target
CONFIG_TARGET_ramips=y
CONFIG_TARGET_ramips_mt76x8=y
CONFIG_TARGET_ramips_mt76x8_DEVICE_vocore_vocore2=y

# images
CONFIG_TARGET_ROOTFS_INITRAMFS=y
CONFIG_TARGET_ROOTFS_SQUASHFS=y

# debug & driver
CONFIG_KERNEL_DEVMEM=y
CONFIG_KERNEL_DEVKMEM=y
CONFIG_PACKAGE_mem=y
CONFIG_PACKAGE_mt7628tool=y

# serial port
CONFIG_PACKAGE_gkermit=y
CONFIG_PACKAGE_lrzsz=y

# sound
CONFIG_PACKAGE_kmod-i2c-core=y
CONFIG_PACKAGE_kmod-i2c-mt7628=y
CONFIG_PACKAGE_kmod-sound-mt7628=y
CONFIG_PACKAGE_alsa-utils=y

# usbdisk
CONFIG_PACKAGE_kmod-usb-storage=y

# sdcard
CONFIG_PACKAGE_kmod-sdhci-mt7620=y

# filesystem
CONFIG_PACKAGE_kmod-fs-vfat=y

# wireless network
CONFIG_PACKAGE_kmod-mt76=y

# web config
CONFIG_PACKAGE_luci=y
```

## uboot/vocore2_defconfig
```kconfig
CONFIG_MIPS=y
CONFIG_SKIP_LOWLEVEL_INIT=y
CONFIG_SYS_MALLOC_LEN=0x1000000
CONFIG_SPL_LIBCOMMON_SUPPORT=y
CONFIG_SPL_LIBGENERIC_SUPPORT=y
CONFIG_NR_DRAM_BANKS=1
CONFIG_ENV_SIZE=0x1000
CONFIG_ENV_OFFSET=0x30000
CONFIG_ENV_SECT_SIZE=0x10000
CONFIG_ENV_VARS_UBOOT_CONFIG=y
CONFIG_DEFAULT_DEVICE_TREE="vocore_vocore2"
CONFIG_SYS_BOOTCOUNT_ADDR=0xb000006c
CONFIG_SPL_SYS_MALLOC_F_LEN=0x40000
CONFIG_SPL=y
CONFIG_SYS_BOOTCOUNT_SINGLEWORD=y
CONFIG_ARCH_MTMIPS=y
CONFIG_SOC_MT7628=y
CONFIG_BOARD_VOCORE2=y
CONFIG_MIPS_CACHE_SETUP=y
CONFIG_MIPS_CACHE_DISABLE=y
CONFIG_RESTORE_EXCEPTION_VECTOR_BASE=y
CONFIG_MIPS_BOOT_FDT=y
CONFIG_SYS_BOOT_GET_CMDLINE=y
CONFIG_SYS_BOOT_GET_KBD=y
CONFIG_SYS_LOAD_ADDR=0x81000000
# CONFIG_FIT is not set
# CONFIG_FIT_SIGNATURE is not set
CONFIG_LEGACY_IMAGE_FORMAT=y
CONFIG_OF_STDOUT_VIA_ALIAS=y
CONFIG_LOGLEVEL=8
# CONFIG_DISPLAY_BOARDINFO is not set
# CONFIG_DISPLAY_BOARDINFO_LATE is not set
CONFIG_SPL_SYS_MALLOC_SIMPLE=y
CONFIG_SPL_NOR_SUPPORT=y
# CONFIG_HUSH_PARSER is not set
# CONFIG_CMDLINE_EDITING is not set
# CONFIG_AUTO_COMPLETE is not set
CONFIG_SYS_LONGHELP=y
# CONFIG_CMD_LICENSE is not set
# CONFIG_BOOTM_NETBSD is not set
# CONFIG_BOOTM_PLAN9 is not set
# CONFIG_BOOTM_RTEMS is not set
# CONFIG_BOOTM_VXWORKS is not set
# CONFIG_CMD_ELF is not set
# CONFIG_CMD_XIMG is not set
# CONFIG_CMD_CRC32 is not set
# CONFIG_ISO_PARTITION is not set
# CONFIG_SPL_DOS_PARTITION is not set
CONFIG_DOS_PARTITION=y
CONFIG_CMD_MEMINFO=y
CONFIG_CMD_FLASH=y
CONFIG_CMD_GPIO=y
CONFIG_CMD_MMC=y
CONFIG_CMD_MTD=y
# CONFIG_CMD_PART is not set
CONFIG_CMD_SPI=y
CONFIG_CMD_USB=y
CONFIG_CMD_WDT=y
# network code is too big. need make it thin.
# CONFIG_NET is not set
# CONFIG_CMD_TFTPBOOT is not set
CONFIG_CMD_FAT=y
CONFIG_CMD_FAT_WRITE=y
CONFIG_CMD_FS_GENERIC=y
CONFIG_CMD_MTDPARTS=y
CONFIG_MTDIDS_DEFAULT="nor0=spi0.0"
CONFIG_MTDPARTS_DEFAULT="spi0.0:192k(u-boot),64k(env),64k(factory),-(kernel)"
CONFIG_ENV_IS_IN_SPI_FLASH=y
CONFIG_SYS_RELOC_GD_ENV_ADDR=y
CONFIG_ENV_VARS_UBOOT_RUNTIME_CONFIG=y
# CONFIG_VERSION_VARIABLE is not set
# CONFIG_NET_RANDOM_ETHADDR is not set
CONFIG_SPL_DM=y
# CONFIG_DM_DEVICE_REMOVE is not set
CONFIG_BOOTCOUNT_LIMIT=y
CONFIG_LED=y
CONFIG_LED_BLINK=y
CONFIG_LED_GPIO=y
CONFIG_MMC=y
# CONFIG_MMC_HW_PARTITIONING is not set
CONFIG_MMC_MTK=y
CONFIG_MTD=y
CONFIG_SPI_FLASH_SFDP_SUPPORT=y
CONFIG_SPI_FLASH_GIGADEVICE=y
CONFIG_SPI_FLASH_MACRONIX=y
CONFIG_SPI_FLASH_SPANSION=y
CONFIG_SPI_FLASH_STMICRO=y
CONFIG_SPI_FLASH_WINBOND=y
CONFIG_SPI_FLASH_MTD=y
# CONFIG_MT7628_ETH is not set
CONFIG_PHY=y
CONFIG_MT76X8_USB_PHY=y
CONFIG_SPECIFY_CONSOLE_INDEX=y
CONFIG_CONS_INDEX=3
CONFIG_SPI=y
CONFIG_MT7621_SPI=y
CONFIG_USB=y
CONFIG_USB_EHCI_HCD=y
CONFIG_USB_EHCI_GENERIC=y
CONFIG_USB_STORAGE=y
CONFIG_WDT=y
CONFIG_WDT_MT7621=y
CONFIG_LZMA=y
CONFIG_SPL_LZMA=y
```

## utils/fbusb/src/Kconfig
```kconfig
menuconfig FB_VOCORE_FBUSB
	tristate "Support for vocore screen"
	depends on FB && USB
	select FB_SYS_COPYAREA
	select FB_SYS_FILLRECT
	select FB_SYS_IMAGEBLIT
	select FB_SYS_FOPS
```
